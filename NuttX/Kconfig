## NuttX/msg_transfer/Kconfig
```kconfig
#
# For a description of the syntax of this configuration file,
# see the file kconfig-language.txt in the NuttX tools repository.
#

config MSG_TRANSFER
	tristate " Message transfer test"
	default n
	---help---
		Enable message transfer test

if MSG_TRANSFER

config MSG_TRANSFER_PROGNAME
	string "Program name"
	default "msg_transfer"
	---help---
		This is the name of the program that will be used when the NSH ELF
		program is installed. Probably not required for our use case

config INIT_TASK_PRIORITY
	int "Init task priority"
	default 100

config INIT_TASK_STACKSIZE
	int "Init task size"
	default 2048 

endif
```

## NuttX/semaphore_shuffle/Kconfig
```kconfig
#
# For a description of the syntax of this configuration file,
# see the file kconfig-language.txt in the NuttX tools repository.
#

config SEMAPHORE_SHUFFLE
	tristate "Semaphore shuffle test"
	default n
	---help---
		Enable semaphore shuffle test

if SEMAPHORE_SHUFFLE

config SEMAPHORE_SHUFFLE_PROGNAME
	string "Program name"
	default "semaphore_shuffle"
	---help---
		This is the name of the program that will be used when the NSH ELF
		program is installed. Probably not required for our use case

config INIT_TASK_PRIORITY
	int "Init task priority"
	default 100

config INIT_TASK_STACKSIZE
	int "Init task size"
	default 2048 

endif
```

## NuttX/size_comparison/Kconfig
```kconfig
#
# For a description of the syntax of this configuration file,
# see the file kconfig-language.txt in the NuttX tools repository.
#

config SIZE_COMPARISON
	tristate "Program for binary size comparison"
	default n
	---help---
		Enable test program for binary size comparison

if SIZE_COMPARISON

config SIZE_COMPARISON_PROGNAME 
	string "Program name"
	default "size_comparison"
	---help---
		This is the name of the program that will be used when the NSH ELF
		program is installed. Probably not required for our use case

config INIT_TASK_PRIORITY
	int "Init task priority"
	default 100

config INIT_TASK_STACKSIZE
	int "Init task size"
	default DEFAULT_TASK_STACKSIZE

endif
```

## NuttX/task_activation/Kconfig
```kconfig
#
# For a description of the syntax of this configuration file,
# see the file kconfig-language.txt in the NuttX tools repository.
#

config TASK_ACTIVATION
	tristate " Task activation latency test"
	default n
	---help---
		Enable task activation latency test

if TASK_ACTIVATION

config TASK_ACTIVATION_PROGNAME
	string "Program name"
	default "task_activation"
	---help---
		This is the name of the program that will be used when the NSH ELF
		program is installed. Probably not required for our use case

config INIT_TASK_PRIORITY
	int "Init task priority"
	default 100

config INIT_TASK_STACKSIZE
	int "Init task size"
	default 2048 

endif
```

## NuttX/task_switching/Kconfig
```kconfig
#
# For a description of the syntax of this configuration file,
# see the file kconfig-language.txt in the NuttX tools repository.
#

config TASK_SWITCHING
	tristate "Task switching test"
	default n
	---help---
		Enable task switching test

if TASK_SWITCHING

config TASK_SWITCHING_PROGNAME 
	string "Program name"
	default "task_switching"
	---help---
		This is the name of the program that will be used when the NSH ELF
		program is installed. Probably not required for our use case

config INIT_TASK_PRIORITY
	int "Init task priority"
	default 100

config INIT_TASK_STACKSIZE
	int "Init task size"
	default DEFAULT_TASK_STACKSIZE

endif
```
