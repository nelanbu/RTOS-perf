# file: semaphore_shuffle.ioc
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CORTEX_M7.ART_ACCELERATOR_ENABLE=0
CORTEX_M7.CPU_DCache=Disabled
CORTEX_M7.CPU_ICache=Disabled
CORTEX_M7.FlashInterface=TCM_Enabled
CORTEX_M7.PREFETCH_ENABLE=0
FREERTOS.BinarySemaphores01=BinarySem,Dynamic,NULL
FREERTOS.Tasks01=init,2,256,initTask,Default,NULL,Dynamic,NULL,NULL;task1,0,256,StartTask,Default,NULL,Dynamic,NULL,NULL;task2,0,256,StartTask,Default,NULL,Dynamic,NULL,NULL
FREERTOS.configENABLE_BACKWARD_COMPATIBILITY=0
FREERTOS.configUSE_MUTEXES=0
Mcu.Family=STM32F7
Mcu.Name=STM32F767ZITx
Mcu.Package=LQFP144
NVIC.PriorityGroup=NVIC_PRIORITYGROUP_4
NVIC.TIM6_DAC_IRQn=true\:15\:0\:false\:false\:true\:false\:false\:true\:true
NVIC.TimeBase=TIM6_DAC_IRQn
NVIC.TimeBaseIP=TIM6
PA13.GPIO_Label=TMS
PA13.Mode=Serial_Wire
PA13.Signal=SYS_JTMS-SWDIO
PA14.GPIO_Label=TCK
PA14.Mode=Serial_Wire
PA14.Signal=SYS_JTCK-SWCLK
PH0/OSC_IN.GPIO_Label=MCO [STM32F103CBT6_PA8]
PH0/OSC_IN.Mode=HSE-External-Oscillator
PH0/OSC_IN.Signal=RCC_OSC_IN
PH1/OSC_OUT.Mode=HSE-External-Oscillator
PH1/OSC_OUT.Signal=RCC_OSC_OUT
ProjectManager.HeapSize=0x200
ProjectManager.StackSize=0x400
ProjectManager.TargetToolchain=STM32CubeIDE
RCC.48MHZClocksFreq_Value=24000000
RCC.AHBFreq_Value=216000000
RCC.APB1CLKDivider=RCC_HCLK_DIV4
RCC.APB1Freq_Value=54000000
RCC.APB1TimFreq_Value=108000000
RCC.APB2CLKDivider=RCC_HCLK_DIV2
RCC.APB2Freq_Value=108000000
RCC.APB2TimFreq_Value=216000000
RCC.CortexFreq_Value=216000000
RCC.HCLKFreq_Value=216000000
RCC.HSE_VALUE=8000000
RCC.HSI_VALUE=16000000
RCC.LSE_VALUE=32768
RCC.PLLM=4
RCC.PLLMUL=RCC_PLL_MUL9
RCC.PLLN=216
RCC.PLLQ=9
RCC.PLLSourceVirtual=RCC_PLLSOURCE_HSE
RCC.PRESCALERUSB=RCC_USBCLKSOURCE_PLL_DIV1_5
RCC.SYSCLKFreq_VALUE=216000000
RCC.SYSCLKSource=RCC_SYSCLKSOURCE_PLLCLK
RCC.SYSCLKSourceVirtual=RCC_SYSCLKSOURCE_PLLCLK
RCC.USBFreq_Value=48000000
RCC.VCOOutputFreq_Value=432000000
VP_FREERTOS_VS_CMSIS_V1.Mode=CMSIS_V1
VP_SYS_VS_tim6.Mode=TIM6
board=NUCLEO-F767ZI

// file: Core/Src/main.c
/* USER CODE BEGIN Header */
/**
  ******************************************************************************
  * @file           : main.c
  * @brief          : Main program body
  ******************************************************************************
  * @attention
  *
  * Copyright (c) 2022 STMicroelectronics.
  * All rights reserved.
  *
  * This software is licensed under terms that can be found in the LICENSE file
  * in the root directory of this software component.
  * If no LICENSE file comes with this software, it is provided AS-IS.
  *
  ******************************************************************************
  */
/* USER CODE END Header */
#include "main.h"
#include "cmsis_os.h"

/* USER CODE BEGIN Includes */
#include "stdio.h"
#include <stdbool.h>
#include "semphr.h"
/* USER CODE END Includes */

/* USER CODE BEGIN PM */
#define TAKE_MEASUREMENT(x)     (x = DWT->CYCCNT)
#define NUM_SAMPLES             (100000)
/* USER CODE END PM */

osThreadId initHandle;
osThreadId task1Handle;
osThreadId task2Handle;
osSemaphoreId BinarySemHandle;
/* USER CODE BEGIN PV */
bool shuffle = false;
/* USER CODE END PV */

void SystemClock_Config(void);
static void MX_GPIO_Init(void);
void initTask(void const * argument);
void StartTask(void const * argument);

/* USER CODE BEGIN PFP */
void DWT_Init();
/* USER CODE END PFP */

/* USER CODE BEGIN 0 */
int _write(int file, char *ptr, int len)
{
 /* Implement your write code here, this is used by puts and printf for example */
    for(int i = 0 ; i < len ; ++i)
    {
        ITM_SendChar((*ptr++));
    }

    return len;
}
/* USER CODE END 0 */

int main(void)
{

  /* MCU Configuration--------------------------------------------------------*/

  /* Reset of all peripherals, Initializes the Flash interface and the Systick. */
  HAL_Init();

  /* Configure the system clock */
  SystemClock_Config();

  /* USER CODE BEGIN SysInit */
  DWT_Init();

  /* USER CODE END SysInit */

  /* Initialize all configured peripherals */
  MX_GPIO_Init();

  /* Create the semaphores(s) */
  /* definition and creation of BinarySem */
  osSemaphoreDef(BinarySem);
  BinarySemHandle = osSemaphoreCreate(osSemaphore(BinarySem), 1);

  /* Create the thread(s) */
  /* definition and creation of init */
  osThreadDef(init, initTask, osPriorityHigh, 0, 256);
  initHandle = osThreadCreate(osThread(init), NULL);

  /* definition and creation of task1 */
  osThreadDef(task1, StartTask, osPriorityNormal, 0, 256);
  task1Handle = osThreadCreate(osThread(task1), NULL);

  /* definition and creation of task2 */
  osThreadDef(task2, StartTask, osPriorityNormal, 0, 256);
  task2Handle = osThreadCreate(osThread(task2), NULL);

  /* Start scheduler */
  osKernelStart();

  /* We should never get here as control is now taken by the scheduler */
  /* Infinite loop */
  while (1)
  {

  }
}

void SystemClock_Config(void)
{
  RCC_OscInitTypeDef RCC_OscInitStruct = {0};
  RCC_ClkInitTypeDef RCC_ClkInitStruct = {0};

  /** Configure the main internal regulator output voltage
  */
  __HAL_RCC_PWR_CLK_ENABLE();
  __HAL_PWR_VOLTAGESCALING_CONFIG(PWR_REGULATOR_VOLTAGE_SCALE1);

  /** Initializes the RCC Oscillators according to the specified parameters
  * in the RCC_OscInitTypeDef structure.
  */
  RCC_OscInitStruct.OscillatorType = RCC_OSCILLATORTYPE_HSE;
  RCC_OscInitStruct.HSEState = RCC_HSE_ON;
  RCC_OscInitStruct.PLL.PLLState = RCC_PLL_ON;
  RCC_OscInitStruct.PLL.PLLSource = RCC_PLLSOURCE_HSE;
  RCC_OscInitStruct.PLL.PLLM = 4;
  RCC_OscInitStruct.PLL.PLLN = 216;
  RCC_OscInitStruct.PLL.PLLP = RCC_PLLP_DIV2;
  RCC_OscInitStruct.PLL.PLLQ = 9;
  RCC_OscInitStruct.PLL.PLLR = 2;
  if (HAL_RCC_OscConfig(&RCC_OscInitStruct) != HAL_OK)
  {
    Error_Handler();
  }

  /** Activate the Over-Drive mode
  */
  if (HAL_PWREx_EnableOverDrive() != HAL_OK)
  {
    Error_Handler();
  }

  /** Initializes the CPU, AHB and APB buses clocks
  */
  RCC_ClkInitStruct.ClockType = RCC_CLOCKTYPE_HCLK|RCC_CLOCKTYPE_SYSCLK
                              |RCC_CLOCKTYPE_PCLK1|RCC_CLOCKTYPE_PCLK2;
  RCC_ClkInitStruct.SYSCLKSource = RCC_SYSCLKSOURCE_PLLCLK;
  RCC_ClkInitStruct.AHBCLKDivider = RCC_SYSCLK_DIV1;
  RCC_ClkInitStruct.APB1CLKDivider = RCC_HCLK_DIV4;
  RCC_ClkInitStruct.APB2CLKDivider = RCC_HCLK_DIV2;

  if (HAL_RCC_ClockConfig(&RCC_ClkInitStruct, FLASH_LATENCY_7) != HAL_OK)
  {
    Error_Handler();
  }
}

static void MX_GPIO_Init(void)
{

  /* GPIO Ports Clock Enable */
  __HAL_RCC_GPIOH_CLK_ENABLE();
  __HAL_RCC_GPIOA_CLK_ENABLE();

}

/* USER CODE BEGIN 4 */
void DWT_Init()
{
    CoreDebug->DEMCR    |= CoreDebug_DEMCR_TRCENA_Msk;
    DWT->CYCCNT         = 0;
    DWT->CTRL           |= DWT_CTRL_CYCCNTENA_Msk;
}
/* USER CODE END 4 */

void initTask(void const * argument)
{
  /* USER CODE BEGIN 5 */
    while (true)
    {
        /* Store current priorities */
        UBaseType_t priority_init    = uxTaskPriorityGet(NULL);
        UBaseType_t priority_shuffle = uxTaskPriorityGet(task1Handle);

        /* Lower priority of "init" task to run task1 and task2 and measure the
         * overhead */
        uint32_t overhead_start = 0;
        uint32_t overhead_stop  = 0;
        shuffle = false;

        TAKE_MEASUREMENT(overhead_start);
        vTaskPrioritySet(NULL, priority_shuffle - 1);
        TAKE_MEASUREMENT(overhead_stop);

        /* Restore initial priority */
        vTaskPrioritySet(NULL, priority_init);

        /* Create new tasks that will shuffle semaphores */
        xTaskCreate((TaskFunction_t)StartTask, "task1", 256, NULL, priority_shuffle, &task1Handle);
        xTaskCreate((TaskFunction_t)StartTask, "task2", 256, NULL, priority_shuffle, &task2Handle);

        /* Run test with shuffling */
        uint32_t shuffle_start = 0;
        uint32_t shuffle_stop  = 0;
        shuffle = true;

        TAKE_MEASUREMENT(shuffle_start);
        vTaskPrioritySet(NULL, priority_shuffle - 1);
        TAKE_MEASUREMENT(shuffle_stop);

        uint32_t shuffle_avg = ((shuffle_stop - shuffle_start) -
                                (overhead_stop - overhead_start)) / NUM_SAMPLES;

        /* Print results */
        printf("------------ Semaphore shuffling test ------------\n");
        printf("Shuffle time total:\t\t %lu\n", shuffle_stop - shuffle_start);
        printf("Overhead total:\t\t\t %lu\n", overhead_stop - overhead_start);
        printf("Shuffle time (avg):\t\t %lu\n", shuffle_avg);
        printf("Done.\n");

        while (true)
        {
            /* do nothing */
        }
    }
  /* USER CODE END 5 */
}

void StartTask(void const * argument)
{
  /* USER CODE BEGIN StartTask */
    for (int i = 0; i < NUM_SAMPLES; i++)
    {
        if (shuffle)
        {
            xSemaphoreTake(BinarySemHandle, portMAX_DELAY);
        }
        taskYIELD();

        if (shuffle)
        {
            xSemaphoreGive(BinarySemHandle);
        }
        taskYIELD();
    }

    vTaskDelete(NULL);
  /* USER CODE END StartTask */
}

void HAL_TIM_PeriodElapsedCallback(TIM_HandleTypeDef *htim)
{
  if (htim->Instance == TIM6) {
    HAL_IncTick();
  }
}

void Error_Handler(void)
{
  __disable_irq();
  while (1)
  {
  }
}
