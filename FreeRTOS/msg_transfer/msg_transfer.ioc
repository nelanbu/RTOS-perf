# file: msg_transfer.ioc
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CORTEX_M7.ART_ACCELERATOR_ENABLE=0
CORTEX_M7.FlashInterface=TCM_Enabled
CORTEX_M7.PREFETCH_ENABLE=0
FREERTOS.Queues01=testQueue,8,uint8_t,0,Dynamic,NULL,NULL
FREERTOS.Tasks01=Init,2,128,init,Default,NULL,Dynamic,NULL,NULL;msgTask1,-1,128,task1,Default,NULL,Dynamic,NULL,NULL;msgTask2,0,128,task2,Default,NULL,Dynamic,NULL,NULL
Mcu.Family=STM32F7
Mcu.Name=STM32F767ZITx
Mcu.Package=LQFP144
NVIC.PriorityGroup=NVIC_PRIORITYGROUP_4
NVIC.TIM6_DAC_IRQn=true\:15\:0\:false\:false\:true\:false\:false\:true\:true
NVIC.TimeBase=TIM6_DAC_IRQn
NVIC.TimeBaseIP=TIM6
PA13.GPIO_Label=TMS
PA13.Mode=Serial_Wire
PA13.Signal=SYS_JTMS-SWDIO
PA14.GPIO_Label=TCK
PA14.Mode=Serial_Wire
PA14.Signal=SYS_JTCK-SWCLK
PH0/OSC_IN.Mode=HSE-External-Oscillator
PH0/OSC_IN.Signal=RCC_OSC_IN
PH1/OSC_OUT.Mode=HSE-External-Oscillator
PH1/OSC_OUT.Signal=RCC_OSC_OUT
ProjectManager.HeapSize=0x200
ProjectManager.StackSize=0x400
ProjectManager.TargetToolchain=STM32CubeIDE
RCC.48MHZClocksFreq_Value=24000000
RCC.AHBFreq_Value=216000000
RCC.APB1CLKDivider=RCC_HCLK_DIV4
RCC.APB1Freq_Value=54000000
RCC.APB1TimFreq_Value=108000000
RCC.APB2CLKDivider=RCC_HCLK_DIV2
RCC.APB2Freq_Value=108000000
RCC.APB2TimFreq_Value=216000000
RCC.CortexFreq_Value=216000000
RCC.HCLKFreq_Value=216000000
RCC.HSE_VALUE=8000000
RCC.HSI_VALUE=16000000
RCC.LSE_VALUE=32768
RCC.PLLM=4
RCC.PLLMUL=RCC_PLL_MUL9
RCC.PLLN=216
RCC.PLLQ=9
RCC.PLLSourceVirtual=RCC_PLLSOURCE_HSE
RCC.PRESCALERUSB=RCC_USBCLKSOURCE_PLL_DIV1_5
RCC.SYSCLKFreq_VALUE=216000000
RCC.SYSCLKSource=RCC_SYSCLKSOURCE_PLLCLK
RCC.SYSCLKSourceVirtual=RCC_SYSCLKSOURCE_PLLCLK
RCC.USBFreq_Value=48000000
RCC.VCOOutputFreq_Value=432000000
VP_FREERTOS_VS_CMSIS_V1.Mode=CMSIS_V1
VP_SYS_VS_tim6.Mode=TIM6
board=NUCLEO-F767ZI

// file: Core/Src/main.c
/* USER CODE BEGIN Header */
/**
  ******************************************************************************
  * @file           : main.c
  * @brief          : Main program body
  ******************************************************************************
  * @attention
  *
  * Copyright (c) 2022 STMicroelectronics.
  * All rights reserved.
  *
  * This software is licensed under terms that can be found in the LICENSE file
  * in the root directory of this software component.
  * If no LICENSE file comes with this software, it is provided AS-IS.
  *
  ******************************************************************************
  */
/* USER CODE END Header */
#include "main.h"
#include "cmsis_os.h"

/* USER CODE BEGIN Includes */
#include "stdio.h"
#include <stdbool.h>

/* USER CODE END Includes */

/* USER CODE BEGIN PM */
#define TAKE_MEASUREMENT(x)     (x = DWT->CYCCNT)
#define NUM_SAMPLES             (100000)
#define MESSAGE_SIZE            (8)
/* USER CODE END PM */

osThreadId InitHandle;
osThreadId msgTask1Handle;
osThreadId msgTask2Handle;
osMessageQId testQueueHandle;
/* USER CODE BEGIN PV */
bool transferEnable = false;
/* USER CODE END PV */

void SystemClock_Config(void);
static void MX_GPIO_Init(void);
void init(void const * argument);
void task1(void const * argument);
void task2(void const * argument);

/* USER CODE BEGIN PFP */
void DWT_Init();
/* USER CODE END PFP */

/* USER CODE BEGIN 0 */
int _write(int file, char *ptr, int len)
{
    for(int i = 0 ; i < len ; ++i)
    {
        ITM_SendChar((*ptr++));
    }

    return len;
}
/* USER CODE END 0 */

int main(void)
{

  /* MCU Configuration--------------------------------------------------------*/

  /* Reset of all peripherals, Initializes the Flash interface and the Systick. */
  HAL_Init();

  /* Configure the system clock */
  SystemClock_Config();

  /* USER CODE BEGIN SysInit */
    DWT_Init();

  /* USER CODE END SysInit */

  /* Initialize all configured peripherals */
  MX_GPIO_Init();

  /* Create the queue(s) */
  /* definition and creation of testQueue */
  osMessageQDef(testQueue, 8, uint8_t);
  testQueueHandle = osMessageCreate(osMessageQ(testQueue), NULL);

  /* Create the thread(s) */
  /* definition and creation of Init */
  osThreadDef(Init, init, osPriorityHigh, 0, 128);
  InitHandle = osThreadCreate(osThread(Init), NULL);

  /* definition and creation of msgTask1 */
  osThreadDef(msgTask1, task1, osPriorityBelowNormal, 0, 128);
  msgTask1Handle = osThreadCreate(osThread(msgTask1), NULL);

  /* definition and creation of msgTask2 */
  osThreadDef(msgTask2, task2, osPriorityNormal, 0, 128);
  msgTask2Handle = osThreadCreate(osThread(msgTask2), NULL);

  /* Start scheduler */
  osKernelStart();

  /* We should never get here as control is now taken by the scheduler */
  /* Infinite loop */
    while (1)
    {

    }
}

void SystemClock_Config(void)
{
  RCC_OscInitTypeDef RCC_OscInitStruct = {0};
  RCC_ClkInitTypeDef RCC_ClkInitStruct = {0};

  /** Configure the main internal regulator output voltage
  */
  __HAL_RCC_PWR_CLK_ENABLE();
  __HAL_PWR_VOLTAGESCALING_CONFIG(PWR_REGULATOR_VOLTAGE_SCALE1);

  /** Initializes the RCC Oscillators according to the specified parameters
  * in the RCC_OscInitTypeDef structure.
  */
  RCC_OscInitStruct.OscillatorType = RCC_OSCILLATORTYPE_HSE;
  RCC_OscInitStruct.HSEState = RCC_HSE_ON;
  RCC_OscInitStruct.PLL.PLLState = RCC_PLL_ON;
  RCC_OscInitStruct.PLL.PLLSource = RCC_PLLSOURCE_HSE;
  RCC_OscInitStruct.PLL.PLLM = 4;
  RCC_OscInitStruct.PLL.PLLN = 216;
  RCC_OscInitStruct.PLL.PLLP = RCC_PLLP_DIV2;
  RCC_OscInitStruct.PLL.PLLQ = 9;
  RCC_OscInitStruct.PLL.PLLR = 2;
  if (HAL_RCC_OscConfig(&RCC_OscInitStruct) != HAL_OK)
  {
    Error_Handler();
  }

  /** Activate the Over-Drive mode
  */
  if (HAL_PWREx_EnableOverDrive() != HAL_OK)
  {
    Error_Handler();
  }

  /** Initializes the CPU, AHB and APB buses clocks
  */
  RCC_ClkInitStruct.ClockType = RCC_CLOCKTYPE_HCLK|RCC_CLOCKTYPE_SYSCLK
                              |RCC_CLOCKTYPE_PCLK1|RCC_CLOCKTYPE_PCLK2;
  RCC_ClkInitStruct.SYSCLKSource = RCC_SYSCLKSOURCE_PLLCLK;
  RCC_ClkInitStruct.AHBCLKDivider = RCC_SYSCLK_DIV1;
  RCC_ClkInitStruct.APB1CLKDivider = RCC_HCLK_DIV4;
  RCC_ClkInitStruct.APB2CLKDivider = RCC_HCLK_DIV2;

  if (HAL_RCC_ClockConfig(&RCC_ClkInitStruct, FLASH_LATENCY_7) != HAL_OK)
  {
    Error_Handler();
  }
}

static void MX_GPIO_Init(void)
{

  /* GPIO Ports Clock Enable */
  __HAL_RCC_GPIOH_CLK_ENABLE();
  __HAL_RCC_GPIOA_CLK_ENABLE();

}

/* USER CODE BEGIN 4 */
void DWT_Init()
{
    CoreDebug->DEMCR    |= CoreDebug_DEMCR_TRCENA_Msk;  // enable DWT
    DWT->CYCCNT         =  0;	                        // set counter to 0
    DWT->CTRL           |= DWT_CTRL_CYCCNTENA_Msk;      // enable the cycle counter
}
/* USER CODE END 4 */

void init(void const * argument)
{
  /* USER CODE BEGIN 5 */
    /* Keep priorities of init task and transferring tasks */
    UBaseType_t priority_init     = uxTaskPriorityGet(NULL);
    UBaseType_t priority_task_low = uxTaskPriorityGet(msgTask1Handle);
    UBaseType_t priority_task_hi  = uxTaskPriorityGet(msgTask2Handle);

    /* Lower priority of "init" task to run task1 and task2 and measure the
     * overhead */
    uint32_t overhead_start = 0;
    uint32_t overhead_stop = 0;
    transferEnable = false;

    TAKE_MEASUREMENT(overhead_start);
    vTaskPrioritySet(NULL, priority_task_low - 1);
    TAKE_MEASUREMENT(overhead_stop);

    /* Restore initial priority */
    vTaskPrioritySet(NULL, priority_init);

    /* Create new tasks that will transfer messages */
    xTaskCreate((TaskFunction_t)task1, "task1", 256, NULL, priority_task_low,
                &msgTask1Handle);
    xTaskCreate((TaskFunction_t)task2, "task2", 256, NULL, priority_task_hi,
                &msgTask2Handle);

    /* Run test with message transfer enabled */
    uint32_t transfer_start = 0;
    uint32_t transfer_stop  = 0;
    transferEnable = true;

    TAKE_MEASUREMENT(transfer_start);
    vTaskPrioritySet(NULL, priority_task_low - 1);
    TAKE_MEASUREMENT(transfer_stop);

    /* Print results */
    uint32_t transfer_avg = ((transfer_stop - transfer_start) -
                            (overhead_stop - overhead_start)) / NUM_SAMPLES;

    printf("------------ Inter-task message transfer test ------------\n");
    printf("Transfer time total:\t\t %lu\n", transfer_stop - transfer_start);
    printf("Overhead total:\t\t\t\t %lu\n",  overhead_stop - overhead_start);
    printf("Transfer time (avg):\t\t %lu\n", transfer_avg);
    printf("Done.\n");

    while (true)
    {
        /* do nothing */
    }
  /* USER CODE END 5 */
}

void task1(void const * argument)
{
  /* USER CODE BEGIN task1 */
    /* Low priority task sends the message */
    uint8_t message[MESSAGE_SIZE] = {0};

    for (int i = 0; i < NUM_SAMPLES; ++i)
    {
        message[0] = i % 256;

        if (transferEnable)
        {
            xQueueSend(testQueueHandle, message, portMAX_DELAY);
        }
    }

    /* Delete itself */
    vTaskDelete(NULL);

  /* USER CODE END task1 */
}

void task2(void const * argument)
{
  /* USER CODE BEGIN task2 */
    uint8_t message[MESSAGE_SIZE] = {0};

    for (int i = 0; i < NUM_SAMPLES; i++)
    {
        if (transferEnable)
        {
            xQueueReceive(testQueueHandle, message, portMAX_DELAY);
        }
    }

    /* Delete itself */
    vTaskDelete(NULL);

  /* USER CODE END task2 */
}

void HAL_TIM_PeriodElapsedCallback(TIM_HandleTypeDef *htim)
{
  if (htim->Instance == TIM6) {
    HAL_IncTick();
  }
}

void Error_Handler(void)
{
  __disable_irq();
  while (1)
  {
  }
}
